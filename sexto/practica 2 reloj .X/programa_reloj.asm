;INSTITUTO POLITECNICO NACIONAL
;CECYT 9 "JUAN DE DIOS BATIZ"
;
;PRACTICA 1
;RELOJ DE TIEMPO REAL CON INTERRUPCIONES. 
;
;GRUPO: 6IM2  EQUIPO:
;
;INTEGRANTES:
;
;
;COMENTARIO DE LO QUE EL PROGRAMA EJECUTARA: 

 LIST P=16F877A;

;#INCLUDE "C:\ARCHIVOS DE PROGRAMA\MICROCHIP\MPASM SUITE\P16F877A.INC";
#INCLUDE "C:\PROGRAM FILES (X86)\MICROCHIP\MPASM SUITE\P16F877A.INC";

;BITS DE CPONFIGURACIÓN

  __CONFIG _XT_OSC & _WDT_OFF & _PWRTE_ON & _BODEN_OFF & _LVP_OFF & _CP_OFF;

;FOSC=4MHZ
;CICLO DE TRABAJO DEL PIC=(1/FOSC)*4=1US.
;T INT= (256-R)*(P)*(1/4000000)*4)= 1MS ;//TIEMPO DE INTERRUPCION.
;R=131    P=8.
;FREC INT = 1/T INT= 1 KHZ.

;REGISTROS DE PROPOSITO GENERAL BANCO  0 DE MEMORIA RAM.

;VARIABLES.

W_TEMP		EQU 0X20;
STATUS_TEMP	EQU 0X21;
PCLATH_TEMP	EQU 0X22;
FSR_TEMP	EQU 0X23;

PRESC_1		EQU 0X24;
PRESC_2		EQU 0X25;
BANDERAS	EQU 0X26;

D_HORAS		EQU 0X27;
U_HORAS		EQU 0X28;
D_MINUTOS	EQU 0X29;
U_MINUTOS	EQU 0X30;
D_SEGUNDOS	EQU	0X31;
U_SEGUNDOS	EQU 0X32;

CONT_MILIS	EQU 0X33;

;CONSTANTES

;ASIGNACIÓIN DE LOS BITS DE LOS PUERTOS DE I/O.
;PUERTO A.
SIN_USORA0       EQU          .0; // SIN USORA0.
SIN_USORA1       EQU          .1; // SIN USORA1.
SIN_USORA2       EQU          .2; // SIN USORA2.
SIN_USORA3       EQU          .3; // SIN USORA3.
SIN_USORA4       EQU          .4; // SIN USORA4.
SIN_USORA5       EQU          .5; // SIN USORA5.

PROGA            EQU    B'00000000'; //PROGRAMACIÓN INICIAL DEL PUERTO A.

;PUERTO B.
D0_LCD            EQU           .0;//SALIDA PARA CONTROLAR.
D1_LCD            EQU           .1;//SALIDA PARA CONTROLAR.
D2_LCD            EQU           .2;//SALIDA PARA CONTROLAR.
D3_LCD            EQU           .3;//SALIDA PARA CONTROLAR.
D4_LCD            EQU           .4;//SALIDA PARA CONTROLAR.
D5_LCD            EQU           .5;//SALIDA PARA CONTROLAR.
D6_LCD            EQU           .6;//SALIDA PARA CONTROLAR.
D7_LCD            EQU           .7;//SALIDA PARA CONTROLAR.

PROGB            EQU   B'00000000'; //PROGRAMACIÓN INICIAL DEL PUERTO B.

;PUERTO C.
RS_LCD           EQU          .0; // SEÑAL DE CONTROL (COMANDO/DATOS).
ENABLE_LCD       EQU          .1; // SEÑAL DE INGRESO DE INFORMACION.
LUZ_LCD          EQU          .2; // SIN USORC2.
SIN_USORC3       EQU          .3; // SIN USORC3.
SIN_USORC4       EQU          .4; // SIN USORC4.
SIN_USORC5       EQU          .5; // SIN USORC5.
SIN_USORC6       EQU          .6; // SIN USORC6.
SIN_USORC7       EQU          .7; // SIN USORC7.

PROGC            EQU    B'11111000'; //PROGRAMACIÓN INICIAL DEL PUERTO C.

;PUERTO D.
SIN_USORD0		 EQU		  .0; // SIN USORD0.
SIN_USORD1		 EQU		  .1; // SIN USORD1.
SIN_USORD2       EQU          .2; // SIN USORD2.
SIN_USORD3       EQU          .3; // SIN USORD3.
SIN_USORD4       EQU          .4; // SIN USORD4.
SIN_USORD5       EQU          .5; // SIN USORD5.
SIN_USORD6       EQU          .6; // SIN USORD6.
SIN_USORD7       EQU          .7; // SIN USORD7.  

PROGD            EQU    B'00000000'; //PROGRAMACIÓN INICIAL DEL PUERTO D.

;PUERTO E.

SIN_USORE0       EQU          .0; // SIN USORE0.
SIN_USORE1       EQU          .1; // SIN USORE1.
SIN_USORE2       EQU          .2; // SIN USORE2.

PROGE            EQU     B'111';  //PROGRMACIÓN INICIAL DEL PUERTO E.

;BANDERAS

BAN_INT			 EQU		  .0;
SIN_USOB1		 EQU		  .1;
SIN_USOB2		 EQU		  .2;
SIN_USOB3		 EQU		  .3;
SIN_USOB4		 EQU		  .4;
SIN_USOB5		 EQU		  .5;
SIN_USOB6		 EQU		  .6;
SIN_USOB7		 EQU		  .7;

;== VECTOR RESET ==

		            ORG 0X0000;
VEC_RESET           CLRF PCLATH;
                    GOTO PROG_PRIN;

;== VECTOR INTERRUPCION ==

                    ORG 0X0004;
VEC_INT             MOVWF W_TEMP;	

					MOVF STATUS,W;
					MOVWF STATUS_TEMP;	
					CLRF STATUS;

					MOVF PCLATH,W;
					MOVWF PCLATH_TEMP;	
					CLRF PCLATH;
		
					MOVF FSR,W;
					MOVWF FSR_TEMP;

					BTFSC INTCON,T0IF;
					CALL RUTINA_INT; 

SAL_INT				MOVLW .131; 
					MOVWF TMR0;
					
					MOVF FSR_TEMP,W;
					MOVWF FSR;
					
					MOVF PCLATH_TEMP,W;
					MOVWF PCLATH;

					MOVF STATUS_TEMP,W;
					MOVWF STATUS;

					RETFIE;

;== INTERRUPCION ==

RUTINA_INT			INCF CONT_MILIS,F;
					INCF PRESC_1,F;
		
					MOVLW .100; 
					XORWF PRESC_1,W; 
					BTFSC STATUS,Z; 
					GOTO SIG_INT; 
					GOTO SAL_RUTINT; 
					
SIG_INT				CLRF PRESC_1;
					INCF PRESC_2,F;
					MOVLW .10;
					XORWF PRESC_2,W;
					BTFSS STATUS,Z;
					GOTO SAL_RUTINT;
					CLRF PRESC_1;
					CLRF PRESC_2;
		
SAL_RUTEXT			BSF BANDERAS,BAN_INT;

SAL_RUTINT			BCF INTCON,T0IF; 
					
					RETURN;
					
;== INICIO ==      

PROG_INI			BSF STATUS,RP0; 
				
					MOVLW 0X82; 
					MOVWF OPTION_REG ^0X80; 

                    MOVLW PROGA;
					MOVWF TRISA ^0X80;

                    MOVLW PROGB;
					MOVWF TRISB ^0X80;

                    MOVLW PROGC;
					MOVWF TRISC ^0X80;

                    MOVLW PROGD;
					MOVWF TRISD ^0X80;

                    MOVLW PROGE;
					MOVWF TRISE ^0X80;

                    MOVLW 0X06;
					MOVWF ADCON1 ^0X80;

					BCF STATUS,RP0; 
	
					MOVLW .131; 
					MOVWF TMR0 ^0X00;

					MOVLW 0XA0;
					MOVWF INTCON ^0X00; 
				
					CLRF PORTB ^0X00;

					MOVLW 0Xff;
					MOVWF PORTC ^0X00;

					CLRF BANDERAS;

					MOVLW 0XFF; '0' IMPORTANTE
					MOVWF U_SEGUNDOS;
					MOVWF D_SEGUNDOS;
					MOVWF U_MINUTOS;
					MOVWF D_MINUTOS;
					MOVWF U_HORAS;
					MOVWF D_HORAS;
											
					RETURN;

;== INICIALIZACION LCD ==

INI_LCD				BCF PORTC,RS_LCD; 
				
					MOVLW 0X38;
					MOVWF PORTB;
					CALL PULSO_ENABLE;

					MOVLW 0X0C;
					MOVWF PORTB;
					CALL PULSO_ENABLE;

					MOVLW 0X01;
					MOVWF PORTB;
					CALL PULSO_ENABLE;

					MOVLW 0X06;
					MOVWF PORTB;
					CALL PULSO_ENABLE;
					
					MOVLW 0X80;
					MOVWF PORTB;
					CALL PULSO_ENABLE;

					BSF PORTC,RS_LCD; 
					
					RETURN;

;== PULSO ENABLE ==

PULSO_ENABLE		BCF PORTC,ENABLE_LCD; PONE EN BAJO ENABLE

					CLRF CONT_MILIS;
ESP_TIEMPO			MOVLW .1;
					XORWF CONT_MILIS,W;
					BTFSS STATUS,Z;
					GOTO ESP_TIEMPO;

					BSF PORTC,ENABLE_LCD; PONE EN ALTO ENABLE 
					
					CLRF CONT_MILIS;
ESP_TIEMPO1			MOVLW .40;
					XORWF CONT_MILIS,W;
					BTFSS STATUS,Z;
					GOTO ESP_TIEMPO1;

					RETURN;

;== PROGRAMA PRINCIPAL ==

PROG_PRIN           CALL PROG_INI;
					CALL INI_LCD;

					
					CALL COMANDO_8A;
					CALL SEPARACIONES;
					
					CALL COMANDO_87;
					CALL SEPARACIONES;
				
								
REI_D_HORA			CALL COMANDO_85;
					MOVLW '0';
					MOVWF D_HORAS;
					MOVWF PORTB;
					CALL PULSO_ENABLE;			

REI_U_HORA			CALL COMANDO_86;
					MOVLW '0';
					MOVWF U_HORAS;
					MOVWF PORTB;
					CALL PULSO_ENABLE;

					MOVLW '2';
					XORWF D_HORAS,W;
					BTFSC STATUS,Z;
					GOTO INC_D_HORAS;

					CALL COMANDO_85;
					MOVF D_HORAS,W;
					MOVWF PORTB;
					CALL PULSO_ENABLE;


REI_D_MIN			CALL COMANDO_88;
					MOVLW '0';
					MOVWF D_MINUTOS;
					MOVWF PORTB;
					CALL PULSO_ENABLE;

					MOVLW '4';
					XORWF U_HORAS,W;
					BTFSC STATUS,Z;
					GOTO INC_U_HORAS;

					CALL COMANDO_86;
					MOVF U_HORAS,W;
					MOVWF PORTB;
					CALL PULSO_ENABLE;


REI_U_MIN			CALL COMANDO_89;
					MOVLW '0';
					MOVWF U_MINUTOS;
					MOVWF PORTB;
					CALL PULSO_ENABLE
	
					MOVLW '6';
					XORWF D_MINUTOS,W;
					BTFSC STATUS,Z;
					GOTO INC_D_MINUTOS;

					CALL COMANDO_88;
					MOVF D_MINUTOS,W;
					MOVWF PORTB;
					CALL PULSO_ENABLE;

					

REI_D_SEG			CALL COMANDO_8B;
					MOVLW '0';
					MOVWF D_SEGUNDOS;
					MOVWF PORTB;
					CALL PULSO_ENABLE;

					MOVLW 0X3A;
					XORWF U_MINUTOS,W;
					BTFSC STATUS,Z;
					GOTO INC_U_MINUTOS;

					CALL COMANDO_89;
					MOVF U_MINUTOS,W;
					MOVWF PORTB;
					CALL PULSO_ENABLE;
				
REI_U_SEG			CALL COMANDO_8C;	
					MOVLW '0';
					MOVWF U_SEGUNDOS;
					MOVWF PORTB;
					CALL PULSO_ENABLE;

				
					MOVLW '6';
					XORWF D_SEGUNDOS,W;
					BTFSC STATUS,Z;
					GOTO INC_U_MINUTOS;

					CALL COMANDO_8B;
					MOVF D_SEGUNDOS,W;
					MOVWF PORTB;
					CALL PULSO_ENABLE;

ESP_INT				BTFSS BANDERAS,BAN_INT;
					GOTO ESP_INT;
					BCF BANDERAS,BAN_INT;
										
					INCF U_SEGUNDOS,F;
				
					MOVLW 0X3A;
					XORWF U_SEGUNDOS,W;
					BTFSC STATUS,Z;
					GOTO INC_D_SEGUNDOS;
					
					CALL COMANDO_8C;
					MOVF U_SEGUNDOS,W;
					MOVWF PORTB;
					CALL PULSO_ENABLE;
					
					GOTO ESP_INT;


INC_D_SEGUNDOS		INCF D_SEGUNDOS,F;
					GOTO REI_U_SEG;

INC_U_MINUTOS		INCF U_MINUTOS,F;
					GOTO REI_D_SEG;

INC_D_MINUTOS		INCF D_MINUTOS,F;
					GOTO REI_U_MIN;

INC_U_HORAS			INCF U_HORAS;
					GOTO REI_D_MIN;

INC_D_HORAS			INCF D_HORAS;
					GOTO REI_U_HORA;

;== SEPARACIONES ==

SEPARACIONES		MOVLW 0X3A;
					MOVWF PORTB;
					CALL PULSO_ENABLE;
					RETURN;		

;== COMANDOS PARA LCD ==
				


COMANDO_8F			BCF PORTC,RS_LCD;
					MOVLW 0X8F;
					MOVWF PORTB;
					CALL PULSO_ENABLE;
					BSF PORTC,RS_LCD;
					RETURN;

COMANDO_8E			BCF PORTC,RS_LCD;
					MOVLW 0X8E;
					MOVWF PORTB;
					CALL PULSO_ENABLE;
					BSF PORTC,RS_LCD;
					RETURN;


COMANDO_8D			BCF PORTC,RS_LCD;
					MOVLW 0X8D;
					MOVWF PORTB;
					CALL PULSO_ENABLE;
					BSF PORTC,RS_LCD;
					RETURN;

COMANDO_8C			BCF PORTC,RS_LCD;
					MOVLW 0X8C;
					MOVWF PORTB;
					CALL PULSO_ENABLE;
					BSF PORTC,RS_LCD;
					RETURN;

COMANDO_8B			BCF PORTC,RS_LCD;
					MOVLW 0X8B;
					MOVWF PORTB;
					CALL PULSO_ENABLE;
					BSF PORTC,RS_LCD;
					RETURN;

COMANDO_8A			BCF PORTC,RS_LCD;
					MOVLW 0X8A;
					MOVWF PORTB;
					CALL PULSO_ENABLE;
					BSF PORTC,RS_LCD;
					RETURN;

COMANDO_89			BCF PORTC,RS_LCD;
					MOVLW 0X89;
					MOVWF PORTB;
					CALL PULSO_ENABLE;
					BSF PORTC,RS_LCD;
					RETURN;

COMANDO_88			BCF PORTC,RS_LCD;
					MOVLW 0X88;
					MOVWF PORTB;
					CALL PULSO_ENABLE;
					BSF PORTC,RS_LCD;
					RETURN;

COMANDO_87			BCF PORTC,RS_LCD;
					MOVLW 0X87;
					MOVWF PORTB;
					CALL PULSO_ENABLE;
					BSF PORTC,RS_LCD;
					RETURN;

COMANDO_86			BCF PORTC,RS_LCD;
					MOVLW 0X86;
					MOVWF PORTB;
					CALL PULSO_ENABLE;
					BSF PORTC,RS_LCD;
					RETURN;

COMANDO_85			BCF PORTC,RS_LCD;
					MOVLW 0X85;
					MOVWF PORTB;
					CALL PULSO_ENABLE;
					BSF PORTC,RS_LCD;
					RETURN;

					END;
